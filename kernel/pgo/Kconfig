## kernel/pgo/Kconfig
```kconfig
# SPDX-License-Identifier: GPL-2.0-only
menu "Profile Guided Optimization (PGO) (EXPERIMENTAL)"

config ARCH_SUPPORTS_PGO_CLANG
	bool

config PGO_CLANG
	bool "Enable clang's PGO-based kernel profiling"
	depends on PROC_FS
	depends on ARCH_SUPPORTS_PGO_CLANG
	depends on CC_IS_CLANG
	help
	  This option enables clang's PGO (Profile Guided Optimization) based
	  code profiling to better optimize the kernel.

	  If unsure, say N.

	  Run a representative workload for your application on a kernel
	  compiled with this option and download the raw profile file from
	  /proc/pgo/vmlinux.profraw. This file needs to be
	  processed with llvm-profdata. It may be merged with other collected
	  raw profiles.

	  Copy the processed profile file to kernel/pgo/vmlinux.profdata
	  and build with PGO_CLANG_USE to produce an optimized kernel.

	  Note that a kernel compiled with profiling flags will be
	  significantly larger and run slower. Also be sure to exclude files
	  from profiling which are not linked to the kernel image to prevent
	  linker errors.

	  Note that the procfs filesystem has to be mounted to access
	  profiling data.

config PGO_CLANG_USE
	bool "Optimize the kernel with a collected PGO profile"
	depends on CC_IS_CLANG && !PGO_CLANG
	help
	  Build with -fprofile-use=kernel/pgo/vmlinux.profdata, an indexed
	  profile made by llvm-profdata merge from raw profiles of a
	  PGO_CLANG kernel. The profile must come from the same clang
	  version and the same source path as this build; functions that
	  changed since it was taken are built without profile data.

	  If unsure, say N.

endmenu
```
